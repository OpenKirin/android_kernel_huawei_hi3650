/* DO NOT EDIT - Automatically generated by python */
/ {
		sunwodaatl_2900_2000k_4400:sunwodaatl_2900_2000k_4400 {
			fcc = <2900>;
			default_rbatt_mohm = <100>;
			id_identify_min = <3767>;
			id_identify_max = <4095>;
			id_voltage_min = <3838>;
			id_voltage_max = <4082>;
			vbat_max = <4400>;
			temp_para = 
						"-32767","0","-1","0","4100","0",
						"0","5","-1","290","4400","0",
						"5","10","-1","870","4400","3",
						"10","45","-1","-1","4400","3",
						"45","50","-1","1015","4400","3",
						"50","32767","-1","0","4400","0";
			vbat_para = 
						"-32767","3400","-1","820","0",
						"3400","32767","-1","-1","0";
			segment_para = 
						"-32767","4150","2900","4208","50",
						"4150","4450","2030","4400","0";
			batt_brand = "sunwodaatl";
			fcc_temp = <3050 3054 3049 3104 3055 3035>;
			fcc_sf_x = <0 100 200 300 400 500>;
			fcc_sf_y = <100 96 94 92 90 88>;
			fcc_sf_cols = <6>;
			pc_sf_rows = <1>;
			pc_sf_cols = <1>;
			pc_sf_row_entries = <0>;
			pc_sf_percent = <100>;
			pc_sf_sf = <100>;
			rbatt_sf_rows = <28>;
			rbatt_sf_cols = <6>;
			rbatt_sf_percent = <100 95 90 85 80 75 70 65 60 55 50 45 40 35 30 25 20 15 10 9 8 7 6 5 4 3 2 1>;
			rbatt_sf_sf = <
			               1816 1087 492 145 111 99
			               1816 1087 492 145 111 99
			               1772 1093 490 144 112 100
			               1707 1095 492 147 114 101
			               1665 1090 494 152 117 104
			               1633 1125 539 161 123 106
			               1468 985 526 174 129 110
			               1483 968 461 188 138 115
			               1469 970 451 188 148 122
			               1448 959 436 154 130 116
			               1484 967 435 138 111 101
			               1541 1031 435 138 112 101
			               1602 1110 454 142 116 104
			               1681 1203 495 147 121 109
			               1772 1317 552 149 123 111
			               1887 1458 603 147 115 101
			               2034 1609 661 146 113 101
			               2241 1765 782 149 114 101
			               3387 1882 747 143 113 104
			               3743 2109 792 144 116 104
			               4091 2393 863 147 116 106
			               4516 2702 950 148 119 108
			               5022 3063 1065 149 118 106
			               5589 3492 1230 150 115 104
			               6219 3994 1378 152 114 104
			               7217 4701 1609 161 119 105
			               8637 5897 2082 181 127 106
			               12029 7845 2971 343 233 116
			              >;
			pc_temp_ocv_rows = <29>;
			pc_temp_ocv_cols = <6>;
			pc_temp_ocv_percent = <100 95 90 85 80 75 70 65 60 55 50 45 40 35 30 25 20 15 10 9 8 7 6 5 4 3 2 1>;
			pc_temp_ocv_ocv = <
			                   4378 4375 4371 4381 4361 4355
			                   4283 4290 4293 4312 4293 4288
			                   4217 4225 4232 4251 4234 4229
			                   4155 4166 4175 4193 4176 4171
			                   4100 4108 4120 4136 4120 4116
			                   4045 4062 4075 4082 4068 4064
			                   3954 3975 4013 4032 4019 4017
			                   3917 3927 3949 3982 3975 3974
			                   3880 3890 3910 3937 3934 3933
			                   3841 3852 3870 3887 3885 3885
			                   3819 3820 3838 3851 3847 3847
			                   3803 3804 3812 3825 3823 3822
			                   3788 3793 3794 3805 3804 3802
			                   3775 3781 3783 3788 3788 3786
			                   3761 3768 3774 3775 3773 3770
			                   3748 3754 3763 3761 3754 3743
			                   3735 3735 3747 3743 3734 3721
			                   3720 3715 3721 3715 3708 3697
			                   3699 3694 3692 3691 3684 3673
			                   3693 3688 3688 3689 3683 3672
			                   3684 3683 3685 3687 3681 3670
			                   3675 3678 3681 3685 3679 3668
			                   3664 3671 3675 3679 3675 3663
			                   3648 3658 3663 3660 3661 3646
			                   3616 3629 3634 3619 3625 3610
			                   3571 3579 3580 3562 3572 3560
			                   3503 3510 3507 3483 3502 3491
			                   3399 3405 3400 3367 3402 3391
			                   3200 3200 3200 3200 3200 3200
			                  >;
		};
};
