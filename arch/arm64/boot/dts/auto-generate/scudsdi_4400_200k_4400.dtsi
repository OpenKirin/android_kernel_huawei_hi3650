/* DO NOT EDIT - Automatically generated by python */
/ {
		scudsdi_4400_200k_4400:scudsdi_4400_200k_4400 {
			fcc = <4400>;
			default_rbatt_mohm = <100>;
			id_identify_min = <2786>;
			id_identify_max = <3312>;
			id_voltage_min = <2941>;
			id_voltage_max = <3167>;
			vbat_max = <4400>;
			temp_para = 
						"-32767","0","-1","0","4100","0",
						"0","5","-1","440","4400","0",
						"5","10","-1","1320","4400","3",
						"10","45","-1","-1","4400","3",
						"45","50","-1","1540","4400","3",
						"50","32767","-1","0","4400","0";
			vbat_para = 
						"-32767","3400","-1","820","0",
						"3400","32767","-1","-1","0";
			segment_para = 
						"-32767","4150","4400","4208","50",
						"4150","4450","3080","4400","0";
			batt_brand = "scudsdi";
			fcc_temp = <4577 4574 4574 4589 4568 4543>;
			fcc_sf_x = <0 100 200 300 400 500>;
			fcc_sf_y = <100 96 94 92 90 88>;
			fcc_sf_cols = <6>;
			pc_sf_rows = <1>;
			pc_sf_cols = <1>;
			pc_sf_row_entries = <0>;
			pc_sf_percent = <100>;
			pc_sf_sf = <100>;
			rbatt_sf_rows = <28>;
			rbatt_sf_cols = <6>;
			rbatt_sf_percent = <100 95 90 85 80 75 70 65 60 55 50 45 40 35 30 25 20 15 10 9 8 7 6 5 4 3 2 1>;
			rbatt_sf_sf = <
			               1670 1032 451 122 95 86
			               1665 1031 451 122 95 86
			               1524 997 458 123 95 86
			               1403 958 458 124 96 87
			               1333 900 461 128 97 87
			               1280 865 480 136 100 88
			               1149 757 452 146 105 89
			               1163 735 401 149 108 93
			               1154 737 405 151 112 96
			               1150 731 392 128 103 93
			               1200 727 387 119 94 86
			               1268 744 386 119 93 86
			               1339 801 400 121 95 87
			               1409 872 442 124 97 89
			               1475 947 493 124 97 88
			               1540 1017 546 123 94 86
			               1612 1094 599 123 95 88
			               1723 1195 675 126 96 88
			               2563 1164 561 121 95 87
			               2706 1238 584 123 95 88
			               2874 1328 620 128 96 91
			               3076 1416 682 124 97 91
			               3277 1551 754 128 99 91
			               3474 1624 813 128 97 89
			               3738 1791 858 127 97 88
			               4020 1941 919 132 97 90
			               4464 2200 1010 139 101 92
			               5332 2567 1226 207 122 93
			              >;
			pc_temp_ocv_rows = <29>;
			pc_temp_ocv_cols = <6>;
			pc_temp_ocv_percent = <100 95 90 85 80 75 70 65 60 55 50 45 40 35 30 25 20 15 10 9 8 7 6 5 4 3 2 1>;
			pc_temp_ocv_ocv = <
			                   4390 4387 4385 4374 4365 4358
			                   4275 4288 4297 4306 4300 4295
			                   4206 4219 4235 4247 4241 4237
			                   4144 4162 4178 4190 4184 4180
			                   4092 4102 4124 4135 4129 4125
			                   4039 4051 4074 4084 4077 4073
			                   3944 3969 4007 4036 4030 4025
			                   3906 3923 3940 3974 3978 3981
			                   3862 3891 3907 3937 3938 3937
			                   3820 3856 3871 3888 3889 3890
			                   3799 3821 3840 3852 3851 3851
			                   3785 3792 3812 3826 3826 3825
			                   3774 3777 3791 3806 3806 3804
			                   3763 3765 3779 3789 3789 3787
			                   3752 3755 3769 3774 3772 3766
			                   3740 3745 3756 3758 3752 3741
			                   3726 3733 3738 3740 3732 3719
			                   3710 3720 3717 3712 3706 3692
			                   3682 3699 3696 3689 3682 3669
			                   3674 3694 3692 3688 3680 3668
			                   3664 3688 3688 3687 3679 3667
			                   3652 3681 3684 3684 3677 3664
			                   3638 3671 3678 3678 3673 3660
			                   3617 3652 3663 3662 3661 3645
			                   3588 3624 3638 3623 3627 3610
			                   3545 3579 3596 3566 3574 3560
			                   3484 3516 3531 3488 3504 3492
			                   3392 3413 3431 3365 3398 3390
			                   3200 3200 3200 3200 3200 3200
			                  >;
		};
};
