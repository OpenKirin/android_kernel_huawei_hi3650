/* DO NOT EDIT - Automatically generated by python */
/ {
		desaylgc_2900_10k_4400:desaylgc_2900_10k_4400 {
			fcc = <2900>;
			default_rbatt_mohm = <100>;
			id_identify_min = <0>;
			id_identify_max = <751>;
			id_voltage_min = <496>;
			id_voltage_max = <553>;
			vbat_max = <4400>;
			temp_para = 
						"-32767","0","-1","0","4100","0",
						"0","5","-1","290","4400","0",
						"5","10","-1","870","4400","3",
						"10","45","-1","-1","4400","3",
						"45","50","-1","1015","4400","3",
						"50","32767","-1","0","4400","0";
			vbat_para = 
						"-32767","3400","-1","820","0",
						"3400","32767","-1","-1","0";
			segment_para = 
						"-32767","4150","2900","4208","50",
						"4150","4450","2030","4400","0";
			batt_brand = "desaylgc";
			fcc_temp = <3101 3075 3069 3108 3073 3060>;
			fcc_sf_x = <0 100 200 300 400 500>;
			fcc_sf_y = <100 96 94 92 90 88>;
			fcc_sf_cols = <6>;
			pc_sf_rows = <1>;
			pc_sf_cols = <1>;
			pc_sf_row_entries = <0>;
			pc_sf_percent = <100>;
			pc_sf_sf = <100>;
			rbatt_sf_rows = <28>;
			rbatt_sf_cols = <6>;
			rbatt_sf_percent = <100 95 90 85 80 75 70 65 60 55 50 45 40 35 30 25 20 15 10 9 8 7 6 5 4 3 2 1>;
			rbatt_sf_sf = <
			               2395 1512 687 133 90 72
			               2389 1511 687 133 90 72
			               2218 1462 688 133 91 73
			               2082 1406 685 137 93 74
			               1999 1375 674 142 95 76
			               1907 1359 752 151 99 78
			               1768 1165 659 166 106 81
			               1762 1137 610 175 114 86
			               1759 1135 606 181 123 92
			               1752 1126 594 144 112 89
			               1773 1137 586 125 90 74
			               1828 1171 589 125 90 75
			               1918 1245 627 129 94 77
			               2033 1339 692 133 99 80
			               2175 1455 782 133 98 80
			               2333 1588 896 129 90 72
			               2495 1724 1036 130 89 72
			               2678 1870 1222 134 90 72
			               4863 2180 1032 131 90 75
			               5151 2399 1135 132 89 76
			               5511 2633 1234 139 91 76
			               5874 2839 1389 139 92 74
			               6195 3104 1525 143 91 75
			               6563 3363 1715 143 92 74
			               6964 3598 1872 155 96 78
			               7466 3898 2033 185 102 79
			               8114 4390 2303 383 113 80
			               9008 5286 2888 954 305 143
			              >;
			pc_temp_ocv_rows = <29>;
			pc_temp_ocv_cols = <6>;
			pc_temp_ocv_percent = <100 95 90 85 80 75 70 65 60 55 50 45 40 35 30 25 20 15 10 9 8 7 6 5 4 3 2 1>;
			pc_temp_ocv_ocv = <
			                   4392 4378 4373 4374 4360 4356
			                   4284 4282 4288 4308 4295 4292
			                   4207 4211 4223 4249 4236 4234
			                   4141 4150 4166 4191 4180 4178
			                   4085 4098 4107 4137 4125 4123
			                   4022 4051 4068 4085 4073 4071
			                   3946 3961 3992 4038 4025 4023
			                   3907 3917 3938 3980 3981 3979
			                   3870 3881 3898 3941 3938 3937
			                   3835 3847 3861 3890 3890 3891
			                   3808 3821 3830 3852 3850 3850
			                   3789 3801 3806 3826 3825 3825
			                   3774 3789 3793 3806 3805 3804
			                   3761 3776 3784 3789 3789 3787
			                   3749 3762 3775 3775 3773 3768
			                   3738 3747 3762 3760 3754 3742
			                   3724 3730 3742 3741 3733 3720
			                   3708 3712 3717 3709 3705 3694
			                   3681 3693 3692 3689 3682 3671
			                   3672 3687 3688 3688 3681 3670
			                   3663 3682 3682 3686 3680 3668
			                   3654 3675 3676 3683 3677 3666
			                   3639 3666 3665 3675 3671 3660
			                   3618 3650 3649 3647 3653 3640
			                   3588 3619 3622 3600 3615 3601
			                   3545 3570 3579 3539 3563 3550
			                   3487 3502 3514 3465 3492 3479
			                   3393 3413 3423 3373 3395 3378
			                   3200 3200 3200 3200 3200 3200
			                  >;
		};
};
