/**
 * Copyright (C) 2014 Hisilicon Ltd.
 *
 *  This program is free software; you can redistribute it and/or modify
 *  it under the terms of the GNU General Public License version 2 as
 *  publishhed by the Free Software Foundation.
 */

/include/ "FRD_TUCL_V4_config.dtsi"
/ {
	hisi,boardid = <3 9 0 3>;
	hisi,boardname = "FRD_TUCL_VN1";
	hisi,modem_id = <0x3C612800>;

};
