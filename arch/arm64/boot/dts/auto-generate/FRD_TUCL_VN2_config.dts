/**
 * Copyright (C) 2014 Hisilicon Ltd.
 *
 *  This program is free software; you can redistribute it and/or modify
 *  it under the terms of the GNU General Public License version 2 as
 *  publishhed by the Free Software Foundation.
 */

/dts-v1/;
/include/ "fastboot.dtsi"
/include/ "FRD_TUCL_VN1_config.dtsi"
/include/ "FRD_TUCL_VN2_pin.dtsi"
/include/ "FRD_TUCL_VN2_hi6402_pin.dtsi"
/include/ "FRD_TUCL_VN2_modem_pin.dtsi"
/ {
	hisi,boardid = <3 9 0 4>;
	hisi,boardname = "FRD_TUCL_VN2";
	hisi,modem_id = <0x3C612C00>;

};
