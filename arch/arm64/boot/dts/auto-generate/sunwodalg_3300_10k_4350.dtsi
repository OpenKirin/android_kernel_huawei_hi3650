/* DO NOT EDIT - Automatically generated by python */
/ {
		sunwodalg_3300_10k_4350:sunwodalg_3300_10k_4350 {
			fcc = <3300>;
			default_rbatt_mohm = <100>;
			id_identify_min = <0>;
			id_identify_max = <751>;
			id_voltage_min = <496>;
			id_voltage_max = <553>;
			vbat_max = <4350>;
			temp_para = 
						"-32767","0","-1","0","4100","0",
						"0","5","-1","330","4350","0",
						"5","10","-1","990","4350","3",
						"10","45","-1","-1","4350","3",
						"45","50","-1","1155","4350","3",
						"50","32767","-1","0","4350","0";
			vbat_para = 
						"-32767","3400","-1","820","0",
						"3400","32767","-1","-1","0";
			segment_para = 
						"-32767","4150","3300","4208","50",
						"4150","4450","2310","4350","0";
			batt_brand = "sunwodalg";
			fcc_temp = <3351 3355 3353 3347 3345 3328>;
			fcc_sf_x = <0 100 200 300 400 500>;
			fcc_sf_y = <100 96 94 92 90 88>;
			fcc_sf_cols = <6>;
			pc_sf_rows = <1>;
			pc_sf_cols = <1>;
			pc_sf_row_entries = <0>;
			pc_sf_percent = <100>;
			pc_sf_sf = <100>;
			rbatt_sf_rows = <28>;
			rbatt_sf_cols = <6>;
			rbatt_sf_percent = <100 95 90 85 80 75 70 65 60 55 50 45 40 35 30 25 20 15 10 9 8 7 6 5 4 3 2 1>;
			rbatt_sf_sf = <
			               2242 1283 561 142 93 77
			               2239 1283 561 142 93 77
			               2104 1283 569 143 95 78
			               2095 1231 568 145 96 79
			               2026 1287 597 149 99 81
			               1759 1205 631 165 103 82
			               1720 1046 514 160 108 86
			               1695 1062 500 176 116 90
			               1695 1042 489 158 115 92
			               1740 1029 468 132 94 79
			               1816 1065 464 131 93 78
			               1919 1149 469 134 95 80
			               2041 1266 512 137 100 83
			               2157 1398 579 138 105 86
			               2259 1515 676 135 101 83
			               2345 1613 785 135 92 79
			               2435 1689 887 141 93 78
			               2539 1773 989 153 95 79
			               4147 1880 824 147 96 83
			               4375 1993 861 146 95 78
			               4637 2181 915 148 96 81
			               4872 2321 978 151 96 81
			               5084 2446 1060 154 96 80
			               5288 2614 1127 156 96 81
			               5629 2748 1170 161 100 83
			               5930 2950 1267 172 100 82
			               6389 3224 1439 194 103 84
			               7284 3811 1832 455 168 143
			              >;
			pc_temp_ocv_rows = <29>;
			pc_temp_ocv_cols = <6>;
			pc_temp_ocv_percent = <100 95 90 85 80 75 70 65 60 55 50 45 40 35 30 25 20 15 10 9 8 7 6 5 4 3 2 1>;
			pc_temp_ocv_ocv = <
			                   4335 4335 4333 4323 4319 4314
			                   4216 4241 4256 4258 4258 4256
			                   4137 4179 4197 4203 4203 4201
			                   4105 4113 4144 4150 4149 4147
			                   4063 4086 4096 4099 4098 4096
			                   3958 4028 4055 4058 4050 4048
			                   3912 3942 3975 3993 4000 4003
			                   3869 3904 3930 3960 3963 3962
			                   3836 3864 3890 3912 3916 3916
			                   3816 3828 3853 3869 3871 3871
			                   3801 3807 3823 3840 3842 3842
			                   3787 3794 3800 3819 3820 3819
			                   3775 3782 3789 3800 3802 3801
			                   3763 3770 3780 3784 3786 3784
			                   3751 3756 3770 3769 3768 3763
			                   3738 3743 3756 3755 3747 3736
			                   3723 3730 3737 3735 3726 3714
			                   3703 3715 3712 3709 3701 3689
			                   3677 3696 3693 3688 3681 3669
			                   3667 3688 3690 3686 3679 3668
			                   3657 3683 3686 3684 3678 3666
			                   3646 3675 3682 3681 3674 3663
			                   3630 3663 3676 3673 3666 3654
			                   3606 3644 3661 3649 3643 3630
			                   3577 3612 3628 3609 3604 3591
			                   3535 3567 3579 3555 3553 3542
			                   3477 3503 3511 3482 3485 3474
			                   3400 3419 3421 3389 3386 3378
			                   3200 3200 3200 3200 3200 3200
			                  >;
		};
};
