/* DO NOT EDIT - Automatically generated by python */
/ {
		sunwodalg_3300_200k_4350:sunwodalg_3300_200k_4350 {
			fcc = <3300>;
			default_rbatt_mohm = <100>;
			id_identify_min = <2786>;
			id_identify_max = <3312>;
			id_voltage_min = <2941>;
			id_voltage_max = <3167>;
			vbat_max = <4350>;
			temp_para = 
						"-32767","0","-1","0","4100","0",
						"0","5","-1","330","4350","0",
						"5","10","-1","990","4350","3",
						"10","45","-1","-1","4350","3",
						"45","50","-1","1155","4350","3",
						"50","32767","-1","0","4350","0";
			vbat_para = 
						"-32767","3400","-1","820","0",
						"3400","32767","-1","-1","0";
			segment_para = 
						"-32767","4150","3300","4208","50",
						"4150","4450","2310","4350","0";
			batt_brand = "sunwodalg";
			fcc_temp = <3278 3283 3278 3286 3282 3267>;
			fcc_sf_x = <0 100 200 300 400 500>;
			fcc_sf_y = <100 96 94 92 90 88>;
			fcc_sf_cols = <6>;
			pc_sf_rows = <1>;
			pc_sf_cols = <1>;
			pc_sf_row_entries = <0>;
			pc_sf_percent = <100>;
			pc_sf_sf = <100>;
			rbatt_sf_rows = <28>;
			rbatt_sf_cols = <6>;
			rbatt_sf_percent = <100 95 90 85 80 75 70 65 60 55 50 45 40 35 30 25 20 15 10 9 8 7 6 5 4 3 2 1>;
			rbatt_sf_sf = <
			               2382 1425 636 133 94 81
			               2381 1425 636 133 94 81
			               2245 1409 647 135 95 82
			               2163 1367 658 138 97 83
			               2121 1401 685 142 99 85
			               1886 1278 705 154 104 86
			               1863 1203 602 155 106 89
			               1852 1201 599 172 115 94
			               1845 1187 577 169 124 100
			               1863 1183 558 133 97 84
			               1908 1204 554 129 94 82
			               1967 1258 563 132 96 83
			               2040 1321 597 137 100 86
			               2128 1410 645 142 105 89
			               2230 1517 709 142 104 86
			               2349 1637 792 136 95 82
			               2478 1765 885 136 95 81
			               2635 1907 1046 139 95 82
			               4412 2048 938 141 98 82
			               4810 2255 984 136 98 83
			               5180 2470 1034 141 97 82
			               5510 2691 1162 143 97 85
			               5924 2893 1251 145 97 83
			               6301 3177 1336 144 97 84
			               6689 3377 1437 147 100 83
			               7167 3723 1628 157 100 86
			               7865 4163 1823 164 104 87
			               9172 4982 2291 233 137 116
			              >;
			pc_temp_ocv_rows = <29>;
			pc_temp_ocv_cols = <6>;
			pc_temp_ocv_percent = <100 95 90 85 80 75 70 65 60 55 50 45 40 35 30 25 20 15 10 9 8 7 6 5 4 3 2 1>;
			pc_temp_ocv_ocv = <
			                   4334 4333 4331 4325 4320 4313
			                   4234 4244 4252 4260 4259 4254
			                   4164 4179 4190 4204 4203 4199
			                   4112 4118 4136 4150 4149 4146
			                   4071 4084 4090 4099 4098 4094
			                   3969 4006 4040 4057 4050 4046
			                   3924 3944 3966 3995 4003 4001
			                   3884 3906 3929 3963 3964 3961
			                   3847 3867 3889 3919 3922 3921
			                   3820 3832 3852 3871 3871 3870
			                   3801 3807 3822 3841 3842 3841
			                   3786 3792 3799 3819 3820 3819
			                   3775 3779 3786 3801 3802 3800
			                   3763 3769 3776 3786 3786 3784
			                   3751 3759 3767 3772 3769 3764
			                   3739 3746 3756 3756 3748 3736
			                   3723 3731 3735 3737 3727 3715
			                   3700 3715 3715 3711 3702 3690
			                   3671 3694 3696 3688 3680 3669
			                   3660 3687 3692 3686 3679 3668
			                   3647 3679 3686 3685 3677 3666
			                   3630 3668 3682 3682 3675 3663
			                   3613 3652 3673 3675 3668 3655
			                   3589 3632 3655 3657 3649 3632
			                   3557 3599 3622 3621 3611 3594
			                   3514 3553 3575 3570 3561 3543
			                   3459 3488 3506 3502 3494 3474
			                   3381 3396 3406 3405 3396 3376
			                   3200 3200 3200 3200 3200 3200
			                  >;
		};
};
