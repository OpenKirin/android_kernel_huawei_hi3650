/**
 * Copyright (C) 2014 Hisilicon Ltd.
 *
 *  This program is free software; you can redistribute it and/or modify
 *  it under the terms of the GNU General Public License version 2 as
 *  publishhed by the Free Software Foundation.
 */

/dts-v1/;
/include/ "fastboot.dtsi"
/include/ "FRD_TUGL_V2_config.dtsi"
/include/ "FRD_TUGL_V4_pin.dtsi"
/include/ "FRD_TUGL_V4_hi6402_pin.dtsi"
/include/ "FRD_TUGL_V4_modem_pin.dtsi"
/ {
	hisi,boardid = <3 9 1 1>;
	hisi,boardname = "FRD_TUGL_V4";
	hisi,modem_id = <0x3C610800>;

	amba {
		i2c4: i2c@FDF0D000 {
			pn547_nfc:nfc@28 {
				pn547,dload = <&gpio27 0 0>;
				status = "ok";
			};
		};
	};
};
