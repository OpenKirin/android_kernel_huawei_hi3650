/* DO NOT EDIT - Automatically generated by python */
/ {
		desaylgc_2900_200k_4400:desaylgc_2900_200k_4400 {
			fcc = <2900>;
			default_rbatt_mohm = <100>;
			id_identify_min = <2786>;
			id_identify_max = <3312>;
			id_voltage_min = <2941>;
			id_voltage_max = <3167>;
			vbat_max = <4400>;
			temp_para = 
						"-32767","0","-1","0","4100","0",
						"0","5","-1","290","4400","0",
						"5","10","-1","870","4400","3",
						"10","45","-1","-1","4400","3",
						"45","50","-1","1015","4400","3",
						"50","32767","-1","0","4400","0";
			vbat_para = 
						"-32767","3400","-1","820","0",
						"3400","32767","-1","-1","0";
			segment_para = 
						"-32767","4150","2900","4208","50",
						"4150","4450","2030","4400","0";
			batt_brand = "desaylgc";
			fcc_temp = <2918 2922 2919 2940 2926 2906>;
			fcc_sf_x = <0 100 200 300 400 500>;
			fcc_sf_y = <100 96 94 92 90 88>;
			fcc_sf_cols = <6>;
			pc_sf_rows = <1>;
			pc_sf_cols = <1>;
			pc_sf_row_entries = <0>;
			pc_sf_percent = <100>;
			pc_sf_sf = <100>;
			rbatt_sf_rows = <28>;
			rbatt_sf_cols = <6>;
			rbatt_sf_percent = <100 95 90 85 80 75 70 65 60 55 50 45 40 35 30 25 20 15 10 9 8 7 6 5 4 3 2 1>;
			rbatt_sf_sf = <
			               2210 1081 483 124 90 77
			               2208 1081 483 124 90 77
			               2071 1076 490 126 92 78
			               1969 1078 492 130 96 80
			               1957 1064 505 136 100 82
			               1903 1145 537 147 104 86
			               1712 1010 570 165 111 90
			               1704 952 454 174 119 93
			               1678 946 438 188 132 102
			               1675 929 408 131 107 87
			               1713 921 405 122 92 80
			               1765 960 402 126 95 82
			               1834 1013 406 132 100 86
			               1918 1088 424 138 106 90
			               2020 1183 463 141 107 89
			               2144 1288 512 137 97 83
			               2296 1429 557 127 93 81
			               2496 1620 622 128 93 80
			               3811 1588 579 135 100 83
			               4225 1714 591 137 98 83
			               4507 1863 621 134 97 82
			               4893 2056 705 133 99 82
			               5170 2248 772 132 96 82
			               5547 2432 833 133 95 82
			               5894 2517 890 147 100 86
			               6328 2762 949 171 104 86
			               6782 3094 995 313 111 87
			               7716 3649 1160 857 206 109
			              >;
			pc_temp_ocv_rows = <29>;
			pc_temp_ocv_cols = <6>;
			pc_temp_ocv_percent = <100 95 90 85 80 75 70 65 60 55 50 45 40 35 30 25 20 15 10 9 8 7 6 5 4 3 2 1>;
			pc_temp_ocv_ocv = <
			                   4386 4384 4380 4373 4366 4360
			                   4294 4305 4309 4316 4311 4305
			                   4221 4237 4248 4259 4254 4249
			                   4157 4180 4191 4202 4198 4193
			                   4113 4121 4138 4148 4144 4139
			                   4056 4086 4093 4097 4091 4087
			                   3960 3997 4041 4053 4043 4039
			                   3918 3937 3958 3989 3995 3994
			                   3877 3898 3919 3951 3953 3952
			                   3845 3862 3877 3894 3898 3897
			                   3827 3829 3846 3859 3860 3860
			                   3812 3811 3820 3833 3834 3834
			                   3798 3799 3800 3811 3812 3812
			                   3784 3787 3787 3794 3794 3793
			                   3770 3775 3778 3778 3777 3772
			                   3754 3757 3765 3762 3755 3744
			                   3737 3737 3741 3736 3730 3719
			                   3717 3717 3712 3705 3700 3686
			                   3690 3696 3697 3688 3680 3668
			                   3682 3689 3693 3686 3679 3667
			                   3671 3682 3687 3684 3677 3665
			                   3661 3674 3680 3679 3674 3662
			                   3643 3663 3666 3665 3665 3651
			                   3621 3646 3644 3631 3640 3624
			                   3586 3613 3610 3583 3599 3584
			                   3539 3565 3565 3522 3545 3531
			                   3468 3495 3499 3446 3474 3460
			                   3372 3394 3396 3357 3374 3360
			                   3200 3200 3200 3200 3200 3200
			                  >;
		};
};
