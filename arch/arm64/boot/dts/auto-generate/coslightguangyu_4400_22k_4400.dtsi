/* DO NOT EDIT - Automatically generated by python */
/ {
		coslightguangyu_4400_22k_4400:coslightguangyu_4400_22k_4400 {
			fcc = <4400>;
			default_rbatt_mohm = <100>;
			id_identify_min = <751>;
			id_identify_max = <1235>;
			id_voltage_min = <949>;
			id_voltage_max = <1051>;
			vbat_max = <4400>;
			temp_para = 
						"-32767","0","-1","0","4100","0",
						"0","5","-1","440","4400","0",
						"5","10","-1","1320","4400","3",
						"10","45","-1","-1","4400","3",
						"45","50","-1","1540","4400","3",
						"50","32767","-1","0","4400","0";
			vbat_para = 
						"-32767","3400","-1","820","0",
						"3400","32767","-1","-1","0";
			segment_para = 
						"-32767","4150","4400","4208","50",
						"4150","4450","3080","4400","0";
			batt_brand = "coslightguangyu";
			fcc_temp = <4531 4529 4529 4549 4533 4502>;
			fcc_sf_x = <0 100 200 300 400 500>;
			fcc_sf_y = <100 96 94 92 90 88>;
			fcc_sf_cols = <6>;
			pc_sf_rows = <1>;
			pc_sf_cols = <1>;
			pc_sf_row_entries = <0>;
			pc_sf_percent = <100>;
			pc_sf_sf = <100>;
			rbatt_sf_rows = <28>;
			rbatt_sf_cols = <6>;
			rbatt_sf_percent = <100 95 90 85 80 75 70 65 60 55 50 45 40 35 30 25 20 15 10 9 8 7 6 5 4 3 2 1>;
			rbatt_sf_sf = <
			               1746 1107 497 127 101 94
			               1743 1106 496 127 101 94
			               1630 1076 493 127 102 94
			               1516 1042 487 128 103 95
			               1463 1015 486 132 104 95
			               1355 988 503 137 107 97
			               1304 889 459 146 110 98
			               1284 882 436 156 117 101
			               1272 868 432 155 124 106
			               1289 860 426 131 114 105
			               1317 886 426 123 101 95
			               1350 927 437 123 101 94
			               1389 973 468 126 102 95
			               1442 1023 512 128 106 98
			               1506 1084 565 129 106 97
			               1584 1160 629 128 101 93
			               1687 1259 712 129 102 94
			               1826 1379 828 132 103 95
			               3080 1624 797 126 103 93
			               3301 1804 886 128 102 96
			               3642 1985 995 130 103 98
			               3878 2205 1128 133 105 100
			               4197 2428 1310 135 106 103
			               4591 2699 1518 135 105 98
			               5165 3028 1720 133 103 94
			               5933 3561 2029 140 105 98
			               7149 4350 2603 151 107 100
			               10565 5848 3595 198 118 103
			              >;
			pc_temp_ocv_rows = <29>;
			pc_temp_ocv_cols = <6>;
			pc_temp_ocv_percent = <100 95 90 85 80 75 70 65 60 55 50 45 40 35 30 25 20 15 10 9 8 7 6 5 4 3 2 1>;
			pc_temp_ocv_ocv = <
			                   4385 4382 4380 4372 4364 4356
			                   4270 4279 4288 4300 4294 4288
			                   4199 4209 4224 4240 4234 4228
			                   4129 4150 4165 4182 4176 4171
			                   4077 4095 4110 4126 4121 4116
			                   3998 4039 4062 4073 4068 4064
			                   3941 3958 3991 4023 4019 4016
			                   3898 3917 3938 3976 3975 3973
			                   3858 3876 3898 3931 3933 3931
			                   3833 3839 3861 3881 3885 3885
			                   3813 3816 3828 3847 3847 3846
			                   3797 3801 3805 3822 3823 3821
			                   3782 3787 3790 3803 3803 3802
			                   3767 3774 3779 3787 3788 3786
			                   3753 3759 3768 3773 3772 3767
			                   3739 3743 3755 3759 3753 3741
			                   3722 3728 3736 3741 3734 3720
			                   3700 3712 3711 3713 3707 3694
			                   3667 3689 3686 3690 3683 3671
			                   3653 3682 3681 3688 3682 3670
			                   3646 3675 3677 3687 3681 3668
			                   3632 3667 3671 3684 3679 3666
			                   3615 3653 3664 3679 3674 3661
			                   3591 3632 3650 3661 3662 3645
			                   3559 3599 3620 3622 3624 3609
			                   3517 3554 3571 3566 3572 3558
			                   3462 3491 3502 3488 3501 3491
			                   3376 3391 3397 3371 3395 3392
			                   3200 3200 3200 3200 3200 3200
			                  >;
		};
};
