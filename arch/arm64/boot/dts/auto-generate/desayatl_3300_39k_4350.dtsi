/* DO NOT EDIT - Automatically generated by python */
/ {
		desayatl_3300_39k_4350:desayatl_3300_39k_4350 {
			fcc = <3300>;
			default_rbatt_mohm = <100>;
			id_identify_min = <1235>;
			id_identify_max = <1759>;
			id_voltage_min = <1420>;
			id_voltage_max = <1562>;
			vbat_max = <4350>;
			temp_para = 
						"-32767","0","-1","0","4100","0",
						"0","5","-1","330","4350","0",
						"5","10","-1","990","4350","3",
						"10","45","-1","-1","4350","3",
						"45","50","-1","1155","4350","3",
						"50","32767","-1","0","4350","0";
			vbat_para = 
						"-32767","3400","-1","820","0",
						"3400","32767","-1","-1","0";
			segment_para = 
						"-32767","4150","3300","4208","50",
						"4150","4450","2310","4350","0";
			batt_brand = "desayatl";
			fcc_temp = <3244 3252 3251 3269 3265 3242>;
			fcc_sf_x = <0 100 200 300 400 500>;
			fcc_sf_y = <100 96 94 92 90 88>;
			fcc_sf_cols = <6>;
			pc_sf_rows = <1>;
			pc_sf_cols = <1>;
			pc_sf_row_entries = <0>;
			pc_sf_percent = <100>;
			pc_sf_sf = <100>;
			rbatt_sf_rows = <28>;
			rbatt_sf_cols = <6>;
			rbatt_sf_percent = <100 95 90 85 80 75 70 65 60 55 50 45 40 35 30 25 20 15 10 9 8 7 6 5 4 3 2 1>;
			rbatt_sf_sf = <
			               2336 1266 538 146 117 106
			               2335 1266 538 146 117 106
			               2147 1261 546 149 118 107
			               2016 1228 557 154 121 109
			               1967 1248 562 158 124 111
			               1736 1199 612 167 130 113
			               1691 1079 543 175 134 117
			               1687 1079 515 188 143 123
			               1670 1063 494 168 137 119
			               1671 1057 481 146 117 108
			               1705 1071 480 145 118 107
			               1750 1121 484 148 121 110
			               1804 1169 506 154 125 113
			               1871 1235 538 159 130 117
			               1957 1310 577 159 126 111
			               2065 1402 628 151 119 109
			               2193 1515 682 150 118 108
			               2367 1657 778 150 119 108
			               3021 1611 764 151 121 111
			               3503 1595 700 152 121 112
			               3826 1741 731 154 121 111
			               4182 1910 788 155 124 112
			               4588 2105 855 157 122 109
			               5042 2321 905 151 120 109
			               5527 2560 967 154 121 110
			               6131 2888 1084 158 125 112
			               6973 3400 1267 169 130 115
			               8797 4279 1710 234 173 145
			              >;
			pc_temp_ocv_rows = <29>;
			pc_temp_ocv_cols = <6>;
			pc_temp_ocv_percent = <100 95 90 85 80 75 70 65 60 55 50 45 40 35 30 25 20 15 10 9 8 7 6 5 4 3 2 1>;
			pc_temp_ocv_ocv = <
			                   4333 4332 4329 4323 4318 4312
			                   4242 4255 4261 4262 4260 4255
			                   4177 4194 4203 4207 4204 4200
			                   4123 4135 4150 4153 4151 4147
			                   4087 4096 4099 4101 4099 4095
			                   3991 4039 4057 4054 4051 4047
			                   3939 3960 3985 4004 4004 4003
			                   3903 3922 3939 3963 3964 3962
			                   3866 3882 3899 3912 3914 3912
			                   3835 3847 3862 3870 3871 3870
			                   3815 3819 3833 3842 3843 3843
			                   3799 3804 3809 3820 3821 3821
			                   3787 3791 3794 3803 3803 3802
			                   3775 3781 3783 3787 3787 3786
			                   3762 3769 3773 3772 3768 3762
			                   3750 3755 3762 3754 3746 3736
			                   3735 3736 3741 3736 3727 3716
			                   3715 3719 3716 3710 3702 3690
			                   3686 3700 3696 3689 3682 3671
			                   3679 3694 3693 3688 3680 3670
			                   3668 3688 3689 3686 3679 3668
			                   3654 3682 3686 3683 3676 3665
			                   3638 3670 3678 3677 3668 3657
			                   3616 3650 3659 3656 3645 3634
			                   3582 3616 3624 3616 3606 3595
			                   3535 3566 3573 3563 3554 3545
			                   3470 3496 3503 3494 3486 3479
			                   3374 3397 3404 3396 3388 3383
			                   3200 3200 3200 3200 3200 3200
			                  >;
		};
};
