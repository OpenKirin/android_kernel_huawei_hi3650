/* DO NOT EDIT - Automatically generated by python */
/ {
		scudsony_3300_470k_4400:scudsony_3300_470k_4400 {
			fcc = <3300>;
			default_rbatt_mohm = <100>;
			id_identify_min = <3312>;
			id_identify_max = <3767>;
			id_voltage_min = <3457>;
			id_voltage_max = <3696>;
			vbat_max = <4400>;
			temp_para = 
						"-32767","0","-1","0","4100","0",
						"0","5","-1","330","4400","0",
						"5","10","-1","990","4400","3",
						"10","45","-1","-1","4400","3",
						"45","50","-1","1155","4400","3",
						"50","32767","-1","0","4400","0";
			vbat_para = 
						"-32767","3400","-1","820","0",
						"3400","32767","-1","-1","0";
			segment_para = 
						"-32767","4150","3300","4208","50",
						"4150","4450","2310","4400","0";
			batt_brand = "scudsony";
			fcc_temp = <3380 3381 3385 3414 3400 3377>;
			fcc_sf_x = <0 100 200 300 400 500>;
			fcc_sf_y = <100 96 94 92 90 88>;
			fcc_sf_cols = <6>;
			pc_sf_rows = <1>;
			pc_sf_cols = <1>;
			pc_sf_row_entries = <0>;
			pc_sf_percent = <100>;
			pc_sf_sf = <100>;
			rbatt_sf_rows = <28>;
			rbatt_sf_cols = <6>;
			rbatt_sf_percent = <100 95 90 85 80 75 70 65 60 55 50 45 40 35 30 25 20 15 10 9 8 7 6 5 4 3 2 1>;
			rbatt_sf_sf = <
			               1526 675 357 149 121 109
			               1526 676 357 149 121 109
			               1558 704 371 154 122 110
			               1541 724 380 158 125 111
			               1513 737 395 164 129 114
			               1496 772 415 172 134 116
			               1371 738 438 182 140 120
			               1359 686 418 198 148 125
			               1356 688 381 205 158 132
			               1362 689 362 173 146 124
			               1381 704 364 152 123 110
			               1425 739 372 154 126 113
			               1491 788 386 160 132 117
			               1568 852 408 165 137 121
			               1678 935 436 169 137 122
			               1793 1048 481 169 131 114
			               1950 1193 525 163 128 115
			               2218 1429 576 170 126 114
			               2453 1472 530 159 127 117
			               2520 1616 543 162 128 118
			               2595 1806 575 162 129 118
			               2779 2028 612 166 130 118
			               3015 2292 666 169 131 117
			               3308 2677 723 169 130 117
			               4053 3121 812 168 128 115
			               4971 3785 914 174 130 117
			               6470 4731 1114 209 145 120
			               8918 6469 1503 352 152 194
			              >;
			pc_temp_ocv_rows = <29>;
			pc_temp_ocv_cols = <6>;
			pc_temp_ocv_percent = <100 95 90 85 80 75 70 65 60 55 50 45 40 35 30 25 20 15 10 9 8 7 6 5 4 3 2 1>;
			pc_temp_ocv_ocv = <
			                   4387 4385 4382 4375 4370 4363
			                   4302 4313 4318 4316 4313 4308
			                   4230 4252 4260 4260 4258 4253
			                   4166 4194 4202 4204 4202 4198
			                   4109 4136 4147 4148 4147 4144
			                   4062 4088 4095 4096 4095 4092
			                   3983 4027 4046 4047 4047 4044
			                   3934 3959 3988 4003 4003 4000
			                   3894 3913 3931 3957 3959 3958
			                   3860 3872 3886 3903 3909 3907
			                   3831 3838 3852 3862 3865 3865
			                   3808 3814 3824 3835 3839 3839
			                   3788 3796 3802 3813 3817 3817
			                   3768 3782 3785 3795 3798 3797
			                   3750 3768 3772 3778 3779 3776
			                   3727 3752 3760 3761 3758 3746
			                   3703 3726 3738 3737 3732 3720
			                   3681 3685 3697 3704 3699 3689
			                   3654 3648 3662 3677 3672 3662
			                   3647 3642 3658 3675 3671 3660
			                   3640 3637 3654 3672 3668 3658
			                   3633 3632 3649 3668 3665 3654
			                   3625 3622 3642 3662 3659 3648
			                   3613 3610 3630 3650 3647 3632
			                   3589 3586 3605 3616 3615 3596
			                   3539 3539 3553 3561 3561 3542
			                   3468 3467 3481 3486 3489 3469
			                   3370 3374 3387 3386 3384 3369
			                   3200 3200 3200 3200 3200 3200
			                  >;
		};
};
