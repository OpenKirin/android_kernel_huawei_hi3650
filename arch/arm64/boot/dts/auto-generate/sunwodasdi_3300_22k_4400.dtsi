/* DO NOT EDIT - Automatically generated by python */
/ {
		sunwodasdi_3300_22k_4400:sunwodasdi_3300_22k_4400 {
			fcc = <3300>;
			default_rbatt_mohm = <100>;
			id_identify_min = <751>;
			id_identify_max = <1235>;
			id_voltage_min = <949>;
			id_voltage_max = <1051>;
			vbat_max = <4400>;
			temp_para = 
						"-32767","0","-1","0","4100","0",
						"0","5","-1","330","4400","0",
						"5","10","-1","990","4400","3",
						"10","45","-1","-1","4400","3",
						"45","50","-1","1155","4400","3",
						"50","32767","-1","0","4400","0";
			vbat_para = 
						"-32767","3400","-1","820","0",
						"3400","32767","-1","-1","0";
			segment_para = 
						"-32767","4150","3300","4208","50",
						"4150","4450","2310","4400","0";
			batt_brand = "sunwodasdi";
			fcc_temp = <3381 3385 3374 3449 3373 3359>;
			fcc_sf_x = <0 100 200 300 400 500>;
			fcc_sf_y = <100 96 94 92 90 88>;
			fcc_sf_cols = <6>;
			pc_sf_rows = <1>;
			pc_sf_cols = <1>;
			pc_sf_row_entries = <0>;
			pc_sf_percent = <100>;
			pc_sf_sf = <100>;
			rbatt_sf_rows = <28>;
			rbatt_sf_cols = <6>;
			rbatt_sf_percent = <100 95 90 85 80 75 70 65 60 55 50 45 40 35 30 25 20 15 10 9 8 7 6 5 4 3 2 1>;
			rbatt_sf_sf = <
			               2012 1536 778 192 136 118
			               2010 1535 778 192 136 118
			               1907 1461 776 192 137 120
			               1796 1380 768 194 139 121
			               1739 1302 763 199 142 122
			               1702 1278 801 211 146 125
			               1520 1078 709 227 152 128
			               1535 1055 650 224 163 133
			               1529 1060 647 218 169 140
			               1517 1042 617 189 149 133
			               1566 1043 607 178 134 119
			               1626 1108 614 178 135 120
			               1692 1182 669 181 138 123
			               1772 1260 743 184 142 126
			               1852 1333 807 184 143 129
			               1951 1402 798 185 138 120
			               2072 1478 843 186 134 119
			               2229 1594 1010 189 135 120
			               3260 1566 895 180 138 122
			               3440 1658 937 180 138 123
			               3585 1788 995 183 135 126
			               3770 1912 1060 186 139 127
			               3991 2042 1134 189 141 127
			               4232 2174 1224 189 136 124
			               4418 2299 1287 191 137 124
			               4760 2444 1333 197 140 125
			               5131 2776 1453 214 147 128
			               5677 3211 1656 406 167 135
			              >;
			pc_temp_ocv_rows = <29>;
			pc_temp_ocv_cols = <6>;
			pc_temp_ocv_percent = <100 95 90 85 80 75 70 65 60 55 50 45 40 35 30 25 20 15 10 9 8 7 6 5 4 3 2 1>;
			pc_temp_ocv_ocv = <
			                   4382 4378 4373 4377 4354 4350
			                   4270 4279 4285 4311 4290 4288
			                   4204 4215 4223 4252 4232 4231
			                   4143 4159 4168 4195 4176 4175
			                   4095 4105 4114 4140 4122 4121
			                   4047 4066 4076 4089 4070 4070
			                   3947 3968 4000 4041 4022 4023
			                   3909 3922 3938 3973 3975 3979
			                   3870 3889 3903 3936 3937 3938
			                   3833 3852 3866 3891 3887 3890
			                   3813 3820 3834 3855 3850 3851
			                   3798 3805 3807 3829 3825 3825
			                   3781 3793 3794 3807 3805 3805
			                   3766 3779 3783 3789 3788 3787
			                   3752 3763 3772 3773 3772 3770
			                   3739 3748 3759 3760 3754 3744
			                   3726 3732 3742 3742 3733 3721
			                   3708 3718 3718 3713 3707 3696
			                   3686 3702 3697 3690 3682 3671
			                   3678 3696 3694 3689 3681 3670
			                   3667 3691 3691 3687 3680 3669
			                   3654 3683 3687 3685 3678 3667
			                   3639 3672 3680 3681 3674 3663
			                   3621 3655 3668 3668 3662 3651
			                   3591 3626 3643 3630 3628 3619
			                   3553 3580 3597 3574 3576 3569
			                   3495 3518 3528 3495 3503 3502
			                   3396 3416 3422 3377 3394 3400
			                   3200 3200 3200 3200 3200 3200
			                  >;
		};
};
