/**
 * Copyright (C) 2014 Hisilicon Ltd.
 *
 *  This program is free software; you can redistribute it and/or modify
 *  it under the terms of the GNU General Public License version 2 as
 *  publishhed by the Free Software Foundation.
 */

/dts-v1/;
/include/ "fastboot.dtsi"
/include/ "FRD_TUGL_V2_config.dtsi"
/include/ "FRD_TL00_V2_pin.dtsi"
/include/ "FRD_TL00_V2_hi6402_pin.dtsi"
/include/ "FRD_TL00_V2_modem_pin.dtsi"
/ {
	hisi,boardid = <3 9 2 0>;
	hisi,boardname = "FRD_TL00_V2";
	hisi,modem_id = <0x3C610800>;
	hisi,product_name = "FRD-TL00";
};
