## block/Kconfig
```kconfig
#
# Block layer core configuration
#
menuconfig BLOCK
       bool "Enable the block layer" if EXPERT
       default y
       help
	 Provide block layer support for the kernel.

	 Disable this option to remove the block layer support from the
	 kernel. This may be useful for embedded devices.

	 If this option is disabled:

	   - block device files will become unusable
	   - some filesystems (such as ext3) will become unavailable.

	 Also, SCSI character devices and USB storage will be disabled since
	 they make use of various block layer definitions and facilities.

	 Say Y here unless you know you really don't want to mount disks and
	 suchlike.

if BLOCK

config LBDAF
	bool "Support for large (2TB+) block devices and files"
	depends on !64BIT
	default y
	help
	  Enable block devices or files of size 2TB and larger.

	  This option is required to support the full capacity of large
	  (2TB+) block devices, including RAID, disk, Network Block Device,
	  Logical Volume Manager (LVM) and loopback.
	
	  This option also enables support for single files larger than
	  2TB.

	  The ext4 filesystem requires that this feature be enabled in
	  order to support filesystems that have the huge_file feature
	  enabled.  Otherwise, it will refuse to mount in the read-write
	  mode any filesystems that use the huge_file feature, which is
	  enabled by default by mke2fs.ext4.

	  The GFS2 filesystem also requires this feature.

	  If unsure, say Y.

config BLK_DEV_BSG
	bool "Block layer SG support v4"
	default y
	help
	  Saying Y here will enable generic SG (SCSI generic) v4 support
	  for any block device.

	  Unlike SG v3 (aka block/scsi_ioctl.c drivers/scsi/sg.c), SG v4
	  can handle complicated SCSI commands: tagged variable length cdbs
	  with bidirectional data transfers and generic request/response
	  protocols (e.g. Task Management Functions and SMP in Serial
	  Attached SCSI).

	  This option is required by recent UDEV versions to properly
	  access device serial numbers, etc.

	  If unsure, say Y.

config BLK_DEV_BSGLIB
	bool "Block layer SG support v4 helper lib"
	default n
	select BLK_DEV_BSG
	help
	  Subsystems will normally enable this if needed. Users will not
	  normally need to manually enable this.

	  If unsure, say N.

config BLK_DEV_INTEGRITY
	bool "Block layer data integrity support"
	select CRC_T10DIF if BLK_DEV_INTEGRITY
	---help---
	Some storage devices allow extra information to be
	stored/retrieved to help protect the data.  The block layer
	data integrity option provides hooks which can be used by
	filesystems to ensure better data integrity.

	Say yes here if you have a storage device that provides the
	T10/SCSI Data Integrity Field or the T13/ATA External Path
	Protection.  If in doubt, say N.

config BLK_DEV_THROTTLING
	bool "Block layer bio throttling support"
	depends on BLK_CGROUP=y
	default n
	---help---
	Block layer bio throttling support. It can be used to limit
	the IO rate to a device. IO rate policies are per cgroup and
	one needs to mount and use blkio cgroup controller for creating
	cgroups and specifying per device IO rate policies.

	See Documentation/cgroups/blkio-controller.txt for more information.

config BLK_CMDLINE_PARSER
	bool "Block device command line partition parser"
	default n
	---help---
	Enabling this option allows you to specify the partition layout from
	the kernel boot args.  This is typically of use for embedded devices
	which don't otherwise have any standardized method for listing the
	partitions on a block device.

	See Documentation/block/cmdline-partition.txt for more information.

config BLOCK_COMPAT
        bool
        depends on BLOCK && COMPAT
        default y

config HISI_BLOCK_FREQUENCE_CONTROL
        bool "add ddr frequence request base on block layer."
        depends on BLOCK
        default n

config MMC_BLOCK_IOMMU_64BIT
        bool "Block bounce limit"
        depends on BLOCK
        default n
        help
        Blk-setting will use address >4G for IOMMU.

config HISI_BLK_MQ
	bool "hisi blk-mq"
	depends on BLOCK
	help
	    hisi block multi queue

config HISI_MQ_DEBUG
	bool "HISI Multi Queue Debug"
	depends on BLOCK
	depends on HISI_BLK_MQ
	default n

config HISI_MQ_DISPATCH_DECISION
	bool "HISI Multi Queue dispatch strategy"
	depends on BLOCK
	depends on HISI_BLK_MQ
	default n
	
config HISI_IO_LATENCY_TRACE
	bool "HISI IO LATENCY trace"
	depends on BLOCK
	default n

config HISI_PARTITION
        bool "hisi partition"
        default n

config HISI_PARTITION_HI3650
        bool "hi3650 partition"
        depends on HISI_PARTITION
        default n
        help
           config partition for hi3650 platform

config HISI_PARTITION_HI6250
        bool "hi6250 partition"
        depends on HISI_PARTITION
        default n
        help
           config partition for hi6250 platform

config HISI_PARTITION_HI3660
        bool "hi3660 partition"
        depends on HISI_PARTITION
        default n
        help
           config partition for hi3660 platform

config HISI_PARTITION_KIRIN970
        bool "kirin970 partition"
        depends on HISI_PARTITION
        default n
        help
           config partition for kirin970 platform

config HW_SYSTEM_WR_PROTECT
	bool "write protection function of system partitions."
	depends on BLOCK
	default n

config HISI_BLK_INLINE_CRYPTO
	bool "Hisi HW inline crytpo support"
	depends on BLOCK
	default n

	help
	 Provide block support for HW inline crytpo support.

	 Select this if you want to use Hardware Crypto Engine
	 and using its interface for some special cryto func.

	 If unsure, say N, hehe!

source block/Kconfig.iosched

endif # BLOCK

menu "Partition Types"

source "block/partitions/Kconfig"

endmenu

source block/Kconfig.iosched
```

## drivers/connectivity/Kconfig
```kconfig
#
# Generic huawei hisi misc drivers configuration
#
menuconfig CONNECTIVITY_HI110X
	bool "Hisilicon Wireless Connectivity Support"
    default n
	---help---
	  If you want to use Hisilicon  Wireless Connectivity, you should set this,
	  and choose one product

menuconfig HI1102_PLATFORM
    tristate "Hisilicon Wireless Connectivity Platform Module"
    depends on CONNECTIVITY_HI110X
    default m
    ---help---
    If you want to use Hisilicon  Wireless Connectivity,first choose this.

menuconfig HI1102_WIFI
    tristate "Hisilicon Wireless Connectivity WiFi Module"
    depends on CONNECTIVITY_HI110X && WIRELESS && CFG80211
    select WIRELESS_EXT
    select WEXT_SPY
    select WEXT_PRIV
    default m
    ---help---
    If you want to use Hisilicon  Wireless Connectivity,first choose this.

if CONNECTIVITY_HI110X
config HI110X_DRIVER_PATH
	string "The Kernel Driver Path"
	default "drivers/connectivity/hisi"
config CONNECTIVITY_HI110X_HI6250
	bool "Connectivity diff between 6250 with 3650"
	default n
config CONNECTIVITY_HI110X_HI3650
	bool "Connectivity diff between 3650 with 6250"
	default n
config CONNECTIVITY_HI110X_HI3660
	bool "Connectivity diff between 3660 with 6250"
	default n

config HI110X_SDIO_STD_CARD_SUPPORT
    bool
    default n

config HI110X_SDIO_FPGA
    bool
    default y

config HI110X_SDIO_NON_STD_CARD_SUPPORT
    bool
    default y
    depends on !HI110X_SDIO_STD_CARD_SUPPORT

config HI110X_SDIO_DETECT_FUNCTION
    bool
    default y


if HI1102_PLATFORM

    config HI1102_PLAT_HW_CHR
    bool "Hisilicon 1102 platform chr log"
    default y
    ---help---
    Hisilicon 1102 platform chr log

   config HI1102_PLAT_OAL
    bool "Hisilicon 1102 platform oal module"
    default y
    select HI110X_SDIO_STD_CARD_SUPPORT
    select HI110X_SDIO_DETECT_FUNCTION
    ---help---
    Hisilicon 1102 platform oal module

   config HI1102_PLAT_FRW
    bool "Hisilicon 1102 platform framework module"
    default y
    ---help---
    Hisilicon 1102 platform oal module

   config HI1102_PLAT_OAM
    bool "Hisilicon 1102 platform oam module"
    default y
    ---help---
    Hisilicon 1102 platform oam module

   config HI1102_PLAT_SDT
    bool "Hisilicon 1102 platform sdt module"
    default y
    ---help---
    Hisilicon 1102 platform sdt module

   config HI1102_PLAT_PS
    bool "Hisilicon 1102 platform ps module"
    default y
    ---help---
    Hisilicon 1102 platform ps module

   config HI1102_PLAT_PM
    bool "Hisilicon 1102 platform power manager module"
    default y
    ---help---
    Hisilicon 1102 platform power manager module

   config HI1102_PLAT_MAIN
    bool "Hisilicon 1102 platform main module"
    default y
    ---help---
    Hisilicon 1102 platform main module
endif

if HI1102_WIFI
config HI1102_WIFI_HMAC
bool "Hisilicon 1102 wifi hmac module"
default y
---help---
Hisilicon 1102 wifi hmac module

config HI1102_WIFI_WAL
bool "Hisilicon 1102 wifi wal module"
default y
---help---
Hisilicon 1102 wifi wal module

config HI1102_WIFI_MAIN
bool "Hisilicon 1102 wifi main module"
default y
---help---
Hisilicon 1102 wifi main module

config HI1102_WIFI_DMAC
bool "Hisilicon 1102 wifi dmac module"
default n
---help---
Hisilicon 1102 wifi dmac module
endif

endif
```

## drivers/contexthub/Kconfig
```kconfig
config CONTEXTHUB
	bool "Sensor CONTEXTHUB driver"
	default n
	help
	Sensor CONTEXTHUB driver.

config CONTEXTHUB_SHMEM
	bool "Sensor CONTEXTHUB SHMEM driver"
	depends on CONTEXTHUB
	default n
	help
	Say yes here if you want to configure contexthub share memory

config CONTEXTHUB_SHELL
	bool "Sensor CONTEXTHUB SHELL DBG driver"
	depends on CONTEXTHUB
	default n
	help
	Say yes here if you want to use contexthub shell dbg function
```

## drivers/cpufreq/hisi/Kconfig.arm
```kconfig
config ARCH_HISI_MAXFREQ
	bool "Hisilicon platform cpu max freq recognition"
	depends on PM_OPP
	default n
	help
	  Hisilicon platform cpu max freq recognition.

config HISI_ENABLE_GET_VAL
	bool "Hisilicon get cpufreq param"
	default n
	help
	  Hisilicon get cpufreq param.

config HISI_BIG_MAXFREQ_HOTPLUG
	tristate "Specific flow for Hisilicon Platform CPUfreq driver"
	depends on ARM_BIG_LITTLE_CPUFREQ && HOTPLUG_CPU
	help
	  This add Hotplug Flow in CPUfreq for Hisilicon Big-little Platform with boost freq.
```

## drivers/devfreq/hisi/Kconfig
```kconfig
config HISI_DEVFREQ
    tristate "Hisilicon DEVFREQ Driver"
    depends on ARCH_HISI && PM_DEVFREQ
    select PM_OPP
    help
      This enables the hisilicon DDRfreq driver.

config HISI_DDR_DEVFREQ
    tristate "Hisilicon DDR DEVFREQ Driver"
    depends on ARCH_HISI && PM_DEVFREQ
    select PM_OPP
    select DEVFREQ_GOV_PM_QOS
    select HISI_DEVFREQ
    help
      This enables the hisilicon DDRfreq driver.

config DEVFREQ_GOV_PM_QOS
	bool "PM QOS"
	help
	  Sets the frequency based on pm_qos throughput constraints.

config DEVFREQ_GOV_MALI_ONDEMAND
    tristate "Hisilicon GPU DEVFREQ Driver"
    depends on ARCH_HISI && PM_DEVFREQ
    select PM_OPP
    select DEVFREQ_GOV_PM_QOS
    select HISI_DEVFREQ
    help
      This enables the hisilicon MALI GPU driver.

config HISI_DDR_CHINTLV
    bool "Hisilicon ddr devfreq chintlv"
    default n
    help
      Deliver register address of GLB_ADDR_INTLV to ATF.

config HISI_DDR_DEVFREQ_DEBUGFS
	bool "Hisilicon ddr devfreq debugfs"
	depends on HI3650_DDR_DEVFREQ && DEBUG_FS
	default n
	help
	  This is a testing driver for HISI ddr devfreq function.
```

## drivers/hisi/ddrc/Kconfig
```kconfig
config HISILICON_PLATFORM_DDRC
	bool "Hisilicon platform ddr controller support"
	default n
	help
	  Say yes here to support the hisilicon platform ddr controller

config HISI_DDRC_FLUX
	bool "Hi3650 ddr bandwith statstic "
	default n

config HI6250_DDRC_FLUX
	bool "Hi6250 ddr bandwith statstic "
	default n

config HI3660_DDRC_FLUX
	bool "Hi3660 ddr bandwith statstic "
	default n
       
config HISI_DDRC_SEC
	bool "hisi ddr secprotect"
	default n
       
config HISI_DDR_AUTO_FSGT
       bool "hisi ddr autofs/autogt"
       default n
```

## drivers/hisi/flp/Kconfig
```kconfig
#
# FLP driver configuration
#

menu "HISI FLP configuration"

config HISI_FLP
	bool "HISI FLP support"
	depends on HISI_SYSCOUNTER
	default n
	---help---
	  Enable support for FLP driver

endmenu
```

## drivers/hisi/mntn/Kconfig
```kconfig
config HISILICON_PLATFORM_MAINTAIN
	bool "Hisilicon platform maintain module support"
	default n
	help
	  Say yes here to support the hisilicon platform maintain module

config HISILICON_PLATFORM_HISI_EASYSHELL
	bool "Support HiSilicon Hi6XXX Easy Shell"
	default n
	help
	  This driver supports HiSilicon HiXXX SOC,
	  including easy shell, etc.
source "drivers/hisi/mntn/blackbox/Kconfig"
source "drivers/hisi/mntn/code_protect/Kconfig"
source "drivers/hisi/mntn/eagle-eye/Kconfig"
source "drivers/hisi/mntn/hisee/Kconfig"

config HISI_VIRT_TO_PHYS
	bool "support converting virtual address to physical address"
	default n
	help
	  Say 'Y' here if you want to support virtual address to physical address enable.

config HISI_BOOT_TIME
	bool "support print all boot slice"
	default n
	help
	  Say 'Y' here if you want to print all boot slice.

config HISI_LOWMEM_DBG
	bool "Hisilicon Low Memory Killer debug"
	default n
	help
	  print processes info when lmk happen per several seconds

config HISI_BB_SYSCALL
	bool "support print system call trace "
	default n
	help
	  Say 'Y' here if you want to print system call trace.

config HISI_POWER_OFF
	bool "Hisilicon platform power off and reset driver"
	default n
	help
	  Power off and reset support for the Hisilicon boards.

config HISI_FIQ
	bool "Hisilicon platform fiq dump driver"
	default n
	help
	   Say 'Y' here if you want to support fiq dump.

config HISI_MNTNDUMP
        bool "Hisilicon platform mntn dump driver"
        default n
        help
           Say 'Y' here if you want to support mntn dump.

config HISI_DEBUG_FS
	bool "Hisilicon platform debugfs"
	depends on DEBUG_FS
	help
		hisi debugfs disable by self
```

## drivers/hisi/mntn/code_protect/Kconfig
```kconfig
menu "MDDRC - For kernel code protection"

config HISI_DDRC_KERNEL_CODE_PROTECTION
	bool "For kernel code protection"
	default n
	help
	  This module is for kernel code protection within ddrc mechanism.
	  Include:
	  kernel code,
	  kernel ro data,
	  etc ...
endmenu
```

## drivers/hisi/mntn/eagle-eye/Kconfig
```kconfig
config HISI_EAGLE_EYE
    bool "Hisilicon Eagle Eye Debug Mechanism"
    depends on LOCKUP_DETECTOR && FUNCTION_TRACER
    default n
    help
    Say 'Y' here if you want to enable kernel to act as a watchdog
    to detect system exceptions in advance, such as task sched
    exception, no timely kicking watchdog and e.t.c.
```

## drivers/hisi/mntn/hisee/Kconfig
```kconfig
config HISI_HISEE_MNTN
    bool "hisee mntn module support"
    default n
    help
      Say yes here to support the hisee mntn module.

config HISI_HISEE_MNTN_TEST
    bool "hisee mntn test"
    default n
    help
      Say yes here to support the hisee mntn test.
```

## drivers/hisi/pm/Kconfig
```kconfig
menu "Hisi S/R options"

config HISI_SR
	bool "support hi3xxx suspend and resume"
	depends on SUSPEND
	default n
	help
	   support hi3xxx suspend and resume

config HISI_SR_DEBUG
	bool "hisi suspend-resume debug interface"
	depends on PM
	default n
	help
	suspend-resume debug for hisi platform

config HISI_SR_DEBUG_SLEEP
	bool "hisi suspend-resume debug sleep"
	depends on PM
	default n
	help
	suspend-resume debug sleep for hisi platform

config HISI_SR_SYNC
	bool "Hisilicon suspend optimization"
	depends on SUSPEND
	default n
	help
	  Driver for suspend optimization

endmenu
```
