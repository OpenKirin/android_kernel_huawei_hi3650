## drivers/hisi/tzdriver/Kconfig
```kconfig
menu "TEE OS"

config SECURE_EXTENSION
	bool "security extension support"
	default n
	help
	  Include Security Extension.

config  TZDRIVER
	tristate "Secure Execution Communicator driver"
	default n
	depends on SECURE_EXTENSION
	help
	  Provides a communication interface between userspace and
	  TrustZone Operating Environment.

config TEELOG
	tristate "Secure Execution Log driver"
	default n
	depends on TZDRIVER
	help
	  TEEOS log

config TEE_TUI
	tristate "Trusted user interface driver"
	default n
	depends on TZDRIVER
	help
	  Trusted user interface diver

config TEE_TUI_HI3650
	tristate "Trusted user interface driver for 3650"
	default n
	depends on TZDRIVER
	help
	  Trusted user interface diver

config TEE_RANDOM
	tristate "TEE based random driver"
	default n
	depends on TZDRIVER
	help
	  TEE based random diver

config HISI_SPI_SMC
	bool "hisi spi smc"
	default n

config HISI_SPI1_SMC
	bool "hisi spi1 smc"
	default n

source drivers/hisi/tzdriver/libhwsecurec/Kconfig

endmenu
```

## drivers/huawei_platform/Kconfig
```kconfig
menu "Huawei Platform Drivers"

menuconfig HUAWEI_PLATFORM
       bool "Huawei platform drivers support"
       default n
       help
       Say yes here to support the huawei platform

if HUAWEI_PLATFORM

source "drivers/huawei_platform/antenna_board_match/Kconfig"
source "drivers/huawei_platform/antenna_fpga/Kconfig"
source "drivers/huawei_platform/audio/Kconfig"
source "drivers/huawei_platform/chr/Kconfig"
source "drivers/huawei_platform/connectivity/Kconfig"
source "drivers/huawei_platform/devdetect/Kconfig"
#source "drivers/huawei_platform/dsm/Kconfig"
source "drivers/huawei_platform/iotrace/Kconfig"
source "drivers/huawei_platform/ext_modem/Kconfig"
source "drivers/huawei_platform/inputhub/iom7/Kconfig"
source "drivers/huawei_platform/irda/Kconfig"
source "drivers/huawei_platform/lcd/Kconfig"
source "drivers/huawei_platform/log/Kconfig"
source "drivers/huawei_platform/mm/Kconfig"
source "drivers/huawei_platform/net/Kconfig"
source "drivers/huawei_platform/nfc/Kconfig"
source "drivers/huawei_platform/power/Kconfig"
source "drivers/huawei_platform/sensor/Kconfig"
source "drivers/huawei_platform/storage/Kconfig"
source "drivers/huawei_platform/touthscreen/Kconfig"
source "drivers/huawei_platform/uid_iostats/Kconfig"
source "drivers/huawei_platform/usb/Kconfig"
source "drivers/huawei_platform/voltage_detection/Kconfig"
source "drivers/huawei_platform/antenna_board_gpio_match/Kconfig"
source "drivers/huawei_platform/vibrator/Kconfig"
source "drivers/huawei_platform/ocp/Kconfig"
source "drivers/huawei_platform/madapt/Kconfig"
source "drivers/huawei_platform/dome_key/Kconfig"
source "drivers/huawei_platform/handpress_switch/Kconfig"
source "drivers/huawei_platform/led_alwayson/Kconfig"
endif #HUAWEI_PLATFORM

endmenu
```

## drivers/huawei_platform/audio/Kconfig
```kconfig
menu "Audio configuration"
config HUAWEI_AUDIO
        bool "Audio support"
        default n
        select REGMAP_I2C
        help
          Enable support for audio
if HUAWEI_AUDIO
source "drivers/huawei_platform/audio/maxim/Kconfig"
source "drivers/huawei_platform/audio/deviceboxID/Kconfig"
source "drivers/huawei_platform/audio/tfa9895/Kconfig"
source "drivers/huawei_platform/audio/tfa98xx/Kconfig"
source "drivers/huawei_platform/audio/earpiece_pa/Kconfig"
source "drivers/huawei_platform/audio/invert_hs/Kconfig"
source "drivers/huawei_platform/audio/anc_hs_module/Kconfig"
source "drivers/huawei_platform/audio/ak4376/Kconfig"
source "drivers/huawei_platform/audio/ak4376-kernel-4-1/Kconfig"
source "drivers/huawei_platform/audio/hifi_vir_dai/Kconfig"
source "drivers/huawei_platform/audio/audio_dmd/Kconfig"
endif # if HUAWEI_AUDIO
endmenu
```

## drivers/huawei_platform/audio/anc_hs_module/Kconfig
```kconfig
menuconfig ANC_HS_MODULE
       bool "ANC headset drivers support"
       default n
       help
       Say yes here to support the ANC headset module

if ANC_HS_MODULE
config ANC_HS_INTERFACE
	tristate "Support for ANC_HS_INTERFACE"
	default n
	---help---
	 Say Y here if you want to support ANC_HS_INTERFACE
config ANC_HS
	tristate "Support for ANC headset"
	default n
	---help---
	 Say Y here if you want to support ANC headset
config ANC_MAX14744
	tristate "Support for ANC MAX14744"
	default n
	---help---
	 Say Y here if you want to support ANC MAX14744
endif #ANC_HS_MODULE
```

## drivers/huawei_platform/audio/audio_dmd/Kconfig
```kconfig
config AUDIO_DMD
	tristate "asd dmd client"
	default n
	help
		Say Y to enable audio DMD driver support
```

## drivers/huawei_platform/audio/earpiece_pa/Kconfig
```kconfig
config EARPA
	tristate "earpice PA driver"
	default n
	help
		Say Y to enable earpice PA driver support
```

## drivers/huawei_platform/inputhub/iom7/Kconfig
```kconfig
menuconfig INPUTHUB
	bool "InputHub feature support"
	default n
	help
	Say yes here to support inputhub feature.

menuconfig IOM3_RECOVERY
	bool "iom3 recovery feature support"
	default n
	help
	Say yes here to support the cmdline parse

menuconfig CYPRESS_PSOC4000
	bool "cypress capsense support"
	default n
	help
	Say yes here if you want to configure cypress capsense
```

## drivers/huawei_platform/iotrace/Kconfig
```kconfig
#HUAWEI IO TRACING


config HUAWEI_IO_TRACING
        tristate "huawei io tracing"
        default n
        depends on TRACING && TASK_XACCT && TASK_IO_ACCOUNTING
        help
            trace the io state for debugging
```

## drivers/huawei_platform/net/Kconfig
```kconfig
source "drivers/huawei_platform/net/ipv4/Kconfig"
source "drivers/huawei_platform/net/hw_netfilter/Kconfig"
source "drivers/huawei_platform/net/commstat/Kconfig"
```

## drivers/huawei_platform/net/ipv4/Kconfig
```kconfig
config HW_CROSSLAYER_OPT
	bool "Huawei network crosslayer optimization"
	default n

config HW_CROSSLAYER_OPT_DBG
	tristate "Huawei network crosslayer information collection"
	depends on HW_CROSSLAYER_OPT && m
	default n

config HW_WIFIPRO
	bool "Huawei wifipro tcp monitor support"
	default n

config HW_WIFIPRO_PROC
	bool "Huawei wifipro proc support"
	depends on HW_WIFIPRO
	default n

config HW_WIFI
	bool "Huawei wifi tcp monitor support"
	default n

config HUAWEI_MSS_AUTO_CHANGE
        bool "Huawei MSS auto change function support"
        default n
```

## drivers/huawei_platform/power/bdat/Kconfig
```kconfig
menu "Huawei Big Data Analysis Tools Support"

config HUAWEI_BDAT
	tristate "Huawei Big Data Analysis Tools support"
	default n
	---help---
	  This driver provides BDAT feature

endmenu
```

## drivers/huawei_platform/touthscreen/panel/Kconfig
```kconfig
#
# huawei touchscreen driver configuration
#

config PARADE_TS
       bool "parade touchscreen"
       default n
       help
         If you say yes here you get support for parade touchscreen.
config SYNAPTICS_TS
	bool "synaptics touchscreen"
	default n
	help
	  If you say yes here you get support for synaptics touchscreen.
config FTS_TS
	bool "fts touchscreen"
	default n
	help
	  If you say yes here you get support for fts touchscreen.
config SYNAPTICS_LCD_TYPE
	bool "synaptics lcd type"
	default n
	help
	  If you say yes here you get support for synaptics touchscreen.
config CYPRESS_TS
	bool "cypress touchscreen"
	default n
	help
	  If you say yes here you get support for cypress touchscreen.
config ATMEL_TS
	bool "atmel touchscreen"
	default n
	help
	  If you say yes here you get support for atmel touchscreen.
config HIDEEP_TS
	bool "hideep crimson touchscreen"
	default n
	help
	  If you say yes here you get support for hideep touchscreen.
menuconfig HW_NOVATEK_TS
	bool "novatek touchscreen"
	default n
	help
	  If you say yes here you get support for novatek touchscreen.
menuconfig ST_TS
	bool "st touchscreen"
	default n
	help
	  If you say yes here you get support for st touchscreen.
menuconfig GOODIX_TS
	bool "goodix touchscreen"
	default n
	help
	  If you say yes here you get support for goodix touchscreen.
```

## drivers/huawei_platform/usb/Kconfig
```kconfig
source "drivers/huawei_platform/usb/switch/Kconfig" 
source "drivers/huawei_platform/usb/otg_gpio_switch/Kconfig"
source "drivers/huawei_platform/usb/typec/Kconfig"
source "drivers/huawei_platform/usb/pd/Kconfig"
source "drivers/huawei_platform/usb/otg_gpio_id/Kconfig"
```
