## drivers/huawei_platform/usb/otg_gpio_id/Kconfig
```kconfig
menuconfig OTGID
	tristate "OTGID class support"
	help
	  Say Y here to enable switch class support. This allows
	  monitoring switches by userspace via sysfs and uevent.

if OTGID

config OTG_GPIO_ID
	tristate "GPIOID support"
	depends on GPIOLIB
	help
	  Say Y here to enable GPIO based switch support.
endif # OTGID
```

## drivers/huawei_platform/vibrator/drv2605/Kconfig
```kconfig
#
#vibator TI2605 driver configuration
#
menuconfig DRV2605
	bool "vibator drv2605 driver"
	default n
	help
	Say yes here to support for vibator drv2605 driver.
```

## drivers/hwbfm/Kconfig
```kconfig
#
# huawei device state monitor configuration
#

config HUAWEI_BFM
	bool "huawei BFM"
	default n
	help
	  If you say yes here you get support for huawei boot fail monitor solution.

config HW_BFMR_HISI
	bool "bfmr for hisi"
	default n
	help
	  If you say yes here you get support for huawei bfmr solution on hisi.

config HW_BFMR_QCOM
	bool "bfmr for qcom"
	default n
	help
	  If you say yes here you get support for huawei bfmr solution on qcom.

source "drivers/hwbfm/hwbfr/Kconfig"
```

## drivers/hwtc/Kconfig
```kconfig
#
# huawei trace counter configuration
#

menuconfig HWTC
	bool "hwtc"
	default n
	help
	  If you say yes here you get support for huawei trace counter.
```

## drivers/media/huawei/camera/Kconfig
```kconfig
comment "Huawei Camera"

# source "drivers/media/huawei/camera/isp/Kconfig"
source "drivers/media/huawei/camera/hisp/Kconfig"
source "drivers/media/huawei/camera/sensor/Kconfig"
source "drivers/media/huawei/camera/laser/Kconfig"

source "drivers/media/huawei/camera/platform/hi3660/Kconfig"
source "drivers/media/huawei/camera/platform/hi3650/Kconfig"
source "drivers/media/huawei/camera/platform/hi3635/Kconfig"
source "drivers/media/huawei/camera/platform/hi6250/Kconfig"

menuconfig HISI_CAMERA_LASER
    bool "Huawei laser support"
    default n
    help
        Say Y here to enable Laser for Huawei camera

menuconfig HUAWEI_CAMERA_USE_EXTISP
    bool "Huawei external ISP support"
    default n
    select SPI
    help
        Say Y here to enable external ISP for Huawei camera

config HISI_CAMERA_HISTAR_ISPV100
    tristate "Support histar ispv100 driver"
    depends on HUAWEI_CAMERA
    default n
    ---help---
        Hisilicon histar ispv100 driver.

config HISI_CAMERA_HISTAR_ISPV110
    tristate "Support histar ispv110 driver"
    depends on HUAWEI_CAMERA
    default n
    ---help---
        Hisilicon histar ispv110 driver.

config HISI_CAMERA_HISTAR_ISPV150
    tristate "Support histar ispv150 driver"
    depends on HUAWEI_CAMERA
    default n
    ---help---
        Hisilicon histar ispv150 driver.

config HISI_CAMERA_ISP_SECURE
    tristate "Support histar isp secure"
    depends on HUAWEI_CAMERA
    default n
    ---help---
        Hisilicon histar isp secure.

if HUAWEI_CAMERA_USE_EXTISP
source "drivers/media/huawei/camera/extisp/Kconfig"
endif
```

## drivers/media/huawei/camera/laser/Kconfig
```kconfig
if HISI_CAMERA_LASER

menu "st camera laser driver support"

config HISI_CAMERA_VL53L0
    tristate "vl53l0 camera laser driver"
    depends on HISI_CAMERA_LASER
    default n
    ---help---
        vl53l0 camera laser driver

config HISI_CAMERA_VL53L0_ML
    tristate "vl53l0_ml camera laser driver"
    depends on HISI_CAMERA_LASER
    default n
    ---help---
        vl53l0 camera laser driver for MHA/LON

config HISI_CAMERA_VL53L0_KNT
    tristate "vl53l0_knt camera laser driver"
    depends on HISI_CAMERA_LASER
    default n
    ---help---
        vl53l0 camera laser driver for KNIGHT

config HISI_CAMERA_VL53L0_GAL
    tristate "vl53l0_gal camera laser driver"
    depends on HISI_CAMERA_LASER
    default n
    ---help---
        vl53l0 camera laser driver for GAL

config HISI_CAMERA_VL53L0_CMB
    tristate "vl53l0_cmb camera laser driver"
    depends on HISI_CAMERA_LASER
    default n
    ---help---
        vl53l0 camera laser driver for CMB

endmenu

endif
```

## drivers/media/huawei/camera/platform/hi3660/Kconfig
```kconfig
comment "Huawei Sensor hi3660"

source "drivers/media/huawei/camera/sensor/vcm/Kconfig"
source "drivers/media/huawei/camera/sensor/flash/Kconfig"
source "drivers/media/huawei/camera/sensor/ois/Kconfig"

config HUAWEI_CAMERA_USE_IMX230
	bool "imx230"
    default y
	depends on HUAWEI_CAMERA

config HUAWEI_CAMERA_USE_IMX298
	bool "imx298"
    default y
	depends on HUAWEI_CAMERA

config HUAWEI_CAMERA_USE_IMX179
	bool "imx179"
    default y
	depends on HUAWEI_CAMERA

config HUAWEI_CAMERA_USE_IMX179_CMB
	bool "imx179_cmb"
    default n
	depends on HUAWEI_CAMERA

config HUAWEI_CAMERA_USE_IMX286DUAL
	bool "imx286dual"
    default y
	depends on HUAWEI_CAMERA

config HUAWEI_CAMERA_USE_IMX286DUAL_CMB
	bool "imx286dual_cmb"
    default n
	depends on HUAWEI_CAMERA

config HUAWEI_CAMERA_USE_OV8865
	bool "ov8865"
    default y
	depends on HUAWEI_CAMERA

config HUAWEI_CAMERA_USE_IMX286HYBIRD
	bool "imx286hybird"
    default y
	depends on HUAWEI_CAMERA

config HUAWEI_CAMERA_USE_IMX386HYBIRD
	bool "imx386hybird"
    default y
	depends on HUAWEI_CAMERA

config HUAWEI_CAMERA_USE_IMX219
	bool "imx219"
    default n
	depends on HUAWEI_CAMERA

config HUAWEI_CAMERA_USE_IMX219_VIC
	bool "imx219_vic"
    default y
	depends on HUAWEI_CAMERA

config HUAWEI_CAMERA_USE_HI843
	bool "hi843"
    default n

config HUAWEI_CAMERA_USE_OV2281
	bool "ov2281"
    default y
	depends on HUAWEI_CAMERA
```

## drivers/media/huawei/camera/platform/hi6250/Kconfig
```kconfig
comment "Huawei Sensor"

source "drivers/media/huawei/camera/sensor/vcm/Kconfig"
source "drivers/media/huawei/camera/sensor/flash/Kconfig"
source "drivers/media/huawei/camera/sensor/ois/Kconfig"

config HUAWEI_CAMERA_USE_IMX214
	bool "imx214"
    default y
	depends on HUAWEI_CAMERA

config HUAWEI_CAMERA_USE_IMX219
	bool "imx219"
    default y
	depends on HUAWEI_CAMERA

config HUAWEI_CAMERA_USE_OV13850
	bool "ov13850"
    default y
	depends on HUAWEI_CAMERA

config HUAWEI_CAMERA_USE_OV8856
	bool "ov8856"
    default y
	depends on HUAWEI_CAMERA

config HUAWEI_CAMERA_USE_OV2680
	bool "ov2680"
    default y
	depends on HUAWEI_CAMERA
	
config HUAWEI_CAMERA_USE_GC2355
	bool "gc2355"
    default y
	depends on HUAWEI_CAMERA

config HUAWEI_CAMERA_USE_HI259
        bool "hi259"
    default y
        depends on HUAWEI_CAMERA

config HUAWEI_CAMERA_USE_HI843
	bool "hi843"
    default y
	depends on HUAWEI_CAMERA

config HUAWEI_CAMERA_USE_T4KA3
	bool "t4ka3"
    default y
	depends on HUAWEI_CAMERA

config HUAWEI_CAMERA_USE_AR1335
	bool "ar1335"
    default y
	depends on HUAWEI_CAMERA
	
config HUAWEI_CAMERA_USE_IMX386
	bool "imx386"
    default y
	depends on HUAWEI_CAMERA

config HUAWEI_CAMERA_USE_OV12870
        bool "ov12870"
    default y
        depends on HUAWEI_CAMERA

config HUAWEI_CAMERA_USE_IMX386E3
	bool "imx386E3"
    default n
	depends on HUAWEI_CAMERA

config HUAWEI_CAMERA_USE_OV12870E3
        bool "ov12870E3"
    default n
        depends on HUAWEI_CAMERA

config HUAWEI_CAMERA_USE_IMX486
	bool "imx486"
    default y
	depends on HUAWEI_CAMERA
```

## drivers/staging/android/hwlogger/Kconfig
```kconfig
config HW_LOGGER
	bool "Huawei log driver"
	default n
	---help---
	  This adds support for system-wide logging using two log buffers.

	  These are:

	      1: hwlog_exception
	      2: hwlog_jank
```

## security/kernel_harden/Kconfig
```kconfig
#
# Huawei Kernel Harden
#

menu "Huawei Kernel Harden"

config HUAWEI_KERNEL_STACK_RANDOMIZE
    bool "stack randomize"
    depends on ARM64
    default n
    help
    Randomizes the base address of process's kernel stack.

config HUAWEI_KERNEL_STACK_RANDOMIZE_STRONG
    bool "stack randomize strong"
    depends on ARM64
    default n
    help
    Randomizes the base address of process's thread_info struct.

config HUAWEI_KERNEL_STACK_NX
    bool "stack non executeable"
    depends on ARM64
    default n
    help
    Set process's kernel stack with non execution.

config HUAWEI_KERNEL_MODULE_RANDOMIZE
    bool "module randomize"
    depends on ARM64
    default n
    help
    Randomizes the base address of loaded kernel module.

endmenu
#a blank line must be existed
```
